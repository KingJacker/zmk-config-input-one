#include <dt-bindings/pinctrl/nrf-pinctrl.h>

&pinctrl {

    spi0_default: spi0_default {
        group1 {
            psels = <NRF_PSEL(SPIM_MOSI, 0, 17)>, <NRF_PSEL(SPIM_SCK, 0, 20)>;
        };
    };

};